## verif/linux/friscv_defconfig
```kconfig
# linux/arch/riscv/configs/friscv_defconfig

CONFIG_ARCH_RV32I=y
CONFIG_NONPORTABLE=y
CONFIG_SMP=n
CONFIG_RISCV_ISA_C=n
CONFIG_FPU=n
CONFIG_RISCV_ISA_V=n
CONFIG_EFI=n

# SBI interface
CONFIG_RISCV_SBI=y
CONFIG_RISCV_SBI_V01=y

# Console / UART
CONFIG_TTY=y
CONFIG_SERIAL_8250=y
CONFIG_SERIAL_8250_CONSOLE=y
CONFIG_SERIAL_OF_PLATFORM=y
CONFIG_SERIAL_EARLYCON=y
CONFIG_SERIAL_EARLYCON_RISCV_SBI=y
CONFIG_HVC_RISCV_SBI=y

# Initramfs
CONFIG_BLK_DEV_INITRD=y

# Filesystem support for init
CONFIG_DEVTMPFS=y
CONFIG_PROC_FS=y
CONFIG_SYSFS=y

# Minimal kernel
CONFIG_PRINTK=y
CONFIG_EMBEDDED=y
CONFIG_MODULES=n
CONFIG_NETWORKING=n
CONFIG_SOUND=n
CONFIG_USB_SUPPORT=n
CONFIG_INPUT=n
CONFIG_HID=n
CONFIG_DRM=n
CONFIG_FB=n
CONFIG_VGA_CONSOLE=n
CONFIG_WLAN=n
CONFIG_WIRELESS=n
CONFIG_BT=n
CONFIG_NEW_LEDS=n
CONFIG_MEDIA_SUPPORT=n
CONFIG_HWMON=n
CONFIG_THERMAL=n
CONFIG_WATCHDOG=n
CONFIG_REGULATOR=n
CONFIG_IOMMU_SUPPORT=n
CONFIG_VIRTIO_MENU=n
CONFIG_VHOST_MENU=n
CONFIG_CRYPTO=n

# Debug
CONFIG_DEBUG_KERNEL=y
CONFIG_EARLY_PRINTK=y
```
